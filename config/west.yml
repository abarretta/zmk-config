## config/west.yml
```yaml
manifest:
  remotes:
    - name: zmkfirmware
      url-base: https://github.com/zmkfirmware
    - name: oledFix
      url-base: https://github.com/abarretta
  projects:
    # - name: zmk
    #   remote: zmkfirmware
    #   revision: v3.0.0+zmk-fixes
    #   import: app/west.yml
    - name: zmk-oled-fix
      remote: oledFix
      revision: v3.0.0+zmk-fixes
      import: app/west.yml
  self:
    path: config
```
